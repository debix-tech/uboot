## board/polyhex/imx93_debix_bmb_13_a1/Kconfig
```kconfig
if TARGET_IMX93_DEBIX_BMB_13_A1

config SYS_BOARD
	default "imx93_debix_bmb_13_a1"

config SYS_VENDOR
	default "polyhex"

config SYS_CONFIG_NAME
	default "imx93_debix_bmb_13_a1"

config IMX93_EVK_LPDDR4X
	bool "Using LPDDR4X Timing and PMIC voltage"
	default y
	select IMX9_LPDDR4X
	help
	  Select the LPDDR4X timing and 0.6V VDDQ

endif
```
